## fw/kernel/arch/arm/mach-dvf99/Kconfig
```kconfig
# SPDX-License-Identifier: GPL-2.0
menuconfig ARCH_DVF99
	bool "DSPG DVF99 (DVF9918 and relatives)"
	depends on ARCH_MULTI_V5
	select CPU_ARM926T
	select GPIOLIB
	select DVF99_PLICU
	select DVF99_TIMER
	help
	  Support for boards built on the DSPG DVF99 family of ARM926 SoCs,
	  such as the Grandstream HT802 analogue telephone adapter.
```

## fw/kernel/arch/arm/mach-ffxav/Kconfig
```kconfig
# SPDX-License-Identifier: GPL-2.0
menuconfig ARCH_FFXAV
	bool "Marvell FFxAV (88E7251, as in the Obihai OBi200)"
	depends on ARCH_MULTI_V5
	select CPU_ARM926T
	select FFXAV_INTC
	select FFXAV_TIMER
	help
	  Support for the Marvell 88E7251 "Link Street Gateway" SoC as the
	  Obihai OBi200 uses it (the maker's name for the platform: FFxAV).
```

## fw/kernel/drivers/misc/v90line/Kconfig
```kconfig
# SPDX-License-Identifier: GPL-2.0
config V90LINE
	bool "v90d telephone line of the HT802"
	depends on ARCH_DVF99
	help
	  FXS port 1 of the Grandstream HT802 as /dev/v90line for the v90d
	  dial-up daemon: the SoC's TDM block, a Si3217x SLIC, the hook.
```
